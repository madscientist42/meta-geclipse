## conf/layer.conf
```bitbake
# We have a conf and classes directory, add to BBPATH
BBPATH .= ":${LAYERDIR}"

# We have a packages directory, add to BBFILES
BBFILES += "${LAYERDIR}/recipes-*/*/*.bb \
            ${LAYERDIR}/recipes-*/*/*.bbappend \
            ${LAYERDIR}/recipes-*/*.bb \
            ${LAYERDIR}/recipes-*/*.bbappend \
            "

BBFILE_COLLECTIONS += "geclipse"
BBFILE_PATTERN_geclipse := "^${LAYERDIR}/"
BBFILE_PRIORITY_geclipse = "4"

# We're going to support a moderately broad range of Yocto
# versions here.  It's presumed that it'll work with more
# than just this, but I am supporting what I work WITH on this
# for myself and any clients I may be doing things for.
LAYERSERIES_COMPAT_geclipse = "honister langdale mickledore"
```
